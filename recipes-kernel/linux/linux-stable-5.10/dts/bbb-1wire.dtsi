&am33xx_pinmux {
	onewire_pin: onewire_pin {
		pinctrl-single,pins = <
			AM33XX_IOPAD(0x848, PIN_INPUT_PULLUP | MUX_MODE7)     /* P9.14, gpio1[18] */
		>;
	};
};

/ {
	onewire@0 {
		status = "okay";
		compatible = "w1-gpio";
		pinctrl-names = "default";
		pinctrl-0 = <&onewire_pin>;
		gpios = <&gpio1 18 0>;
	};
};
