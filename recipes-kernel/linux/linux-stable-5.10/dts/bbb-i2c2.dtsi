
&am33xx_pinmux {
	i2c2_pins: i2c2_pins {
		pinctrl-single,pins = <
			AM33XX_IOPAD(0x978, SLEWCTRL_SLOW | PIN_INPUT_PULLUP | MUX_MODE3)  /* P9.20, i2c2_sda */
			AM33XX_IOPAD(0x97c, SLEWCTRL_SLOW | PIN_INPUT_PULLUP | MUX_MODE3)  /* P9.19, i2c2_scl */
		>;
	};
};

&i2c2 {
	status = "okay";
	pinctrl-names = "default";
	pinctrl-0 = <&i2c2_pins>;
	clock-frequency = <100000>;
};

