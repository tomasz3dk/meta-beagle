## conf/layer.conf
```bitbake
# We have a conf and classes directory, add to BBPATH
BBPATH .= ":${LAYERDIR}:${LAYERDIR}/common"

# We have recipes-* directories, add to BBFILES
BBFILES += " \
	    ${LAYERDIR}/recipes-*/*/*.bb \
	    ${LAYERDIR}/recipes-*/*/*.bbappend \
	    ${LAYERDIR}/recipes-*/*.bb \
		${LAYERDIR}/recipes-*/*.bbappend \
"
                                                                                                                                
BBFILE_COLLECTIONS += ""
BBFILE_PRIORITY_beagle = "5"

# Additional license directories.
LICENSE_PATH += "${LAYERDIR}/licenses"

LAYERDEPENDS_beagle = "qt5"
LAYERRECOMMENDS_beagle = ""

LAYERVERSION_beagle = "1"
LAYERSERIES_COMPAT_beagle = "gatesgarth"


require ${LAYERDIR}/conf/include/maintainers.inc
```

## conf/machine/beagle.conf
```bitbake
#@TYPE: Machine
#@NAME: Beagle
#@DESCRIPTION: Machine configuration for the Beagle with display cape

SOC_FAMILY = "ti335x"
TARGET_ARCH = "arm"

DEFAULTTUNE ?= "cortexa8hf-neon"

require conf/machine/include/soc-family.inc
require conf/machine/include/tune-cortexa8.inc

PREFERRED_PROVIDER_virtual/kernel = "linux-stable"
KERNEL_IMAGETYPE = "zImage"
KERNEL_DEVICETREE ?= "am335x-bone.dtb \
    am335x-boneblack.dtb \
    beagle-chipsee.dtb \
"
PREFERRED_PROVIDER_virtual/bootloader = "u-boot"
PREFERRED_PROVIDER_u-boot = "u-boot"

UBOOT_ENTRYPOINT = "0x80008000"
UBOOT_LOADADDRESS = "0x80008000"
UBOOT_MACHINE = "am335x_evm_config"
BOOTENV_SIZE = "0x20000"

EXTRA_IMAGEDEPENDS += "u-boot"
SPL_BINARY = "MLO"
UBOOT_SUFFIX = "img"
MACHINE_FEATURES = "usbgadget usbhost vfat alsa"

IMAGE_BOOT_FILES ?= "u-boot.${UBOOT_SUFFIX} MLO zImage am335x-bone.dtb am335x-boneblack.dtb beagle-chipsee.dtb uEnv.txt"
IMAGE_FSTYPES += "ext4 wic wic.bmap"
EXTRA_IMAGECMD_jffs2 = "-lnp "
WKS_FILE ?= "beagle.wks"
IMAGE_INSTALL_append = " kernel-devicetree kernel-image-zimage"
do_image_wic[depends] += "mtools-native:do_populate_sysroot dosfstools-native:do_populate_sysroot u-boot:do_deploy"

SERIAL_CONSOLES = "115200;ttyO0"

MACHINE_ESSENTIAL_EXTRA_RDEPENDS = "kernel-image kernel-devicetree"

MACHINE_FEATURES = "ext2 serial usbhost vfat"

ICECC_USER_PACKAGE_BL += " \
    qtlocation \
"
```
